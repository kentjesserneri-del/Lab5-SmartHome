## Lab5_Sensor/sdkconfig.defaults
```kconfig
CONFIG_ESPTOOLPY_FLASHSIZE_4MB=y
CONFIG_ESPTOOLPY_FLASHSIZE="4MB"
CONFIG_PARTITION_TABLE_CUSTOM=y
CONFIG_PARTITION_TABLE_CUSTOM_FILENAME="partitions.csv"
CONFIG_PARTITION_TABLE_OFFSET=0x8000
CONFIG_PARTITION_TABLE_MD5=y
CONFIG_BT_ENABLED=y
CONFIG_BT_NIMBLE_ENABLED=y
# CONFIG_BT_BLUEDROID_ENABLED is not set
CONFIG_BTDM_CTRL_MODE_BLE_ONLY=y
CONFIG_ESP_RMAKER_ASSISTED_CLAIM=y
CONFIG_APP_NETWORK_PROV_SHOW_QR=y
CONFIG_APP_NETWORK_PROV_TRANSPORT_BLE=y
CONFIG_APP_PROV_SECURITY_VERSION_2=y
CONFIG_LOG_COLORS=n
```
